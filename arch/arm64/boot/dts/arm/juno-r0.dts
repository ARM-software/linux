/*
 * ARM Ltd. Juno Platform
 *
 * Copyright (c) 2015 ARM Ltd.
 *
 * This file is licensed under a dual GPLv2 or BSD license.
 */

#include "juno-r0.dtsi"

/ {
	gpu_secure_switch: secure-mode-switcher {
		compatible = "arm,secure-mode-switcher";
		arm,smc,secure_enable = <0xff06>;
		arm,smc,secure_disable = <0xff07>;
	};

	gpu: gpu@2d000000 {
		compatible = "arm,mali-midgard";
		#cooling-cells = <2>; /* min followed by max */
		reg = <0x0 0x2d000000 0x0 0x4000>;
		interrupts = <0 33 4>, <0 34 4>, <0 32 4>;
		interrupt-names = "JOB", "MMU", "GPU";
		clocks = <&scpi_dvfs 2>;
		clock-names = "clk_mali";
		system-coherency = <0>;
		secure-mode-switcher = <&gpu_secure_switch>;
		operating-points = <
			/* KHz uV */
			450000 820000
			487500 825000
			525000 850000
			562500 875000
			600000 900000
		>;
		power_model {
			compatible = "arm,mali-simple-power-model";
			voltage = <800>;
			frequency = <500>;
			static-power = <500>;
			dynamic-power = <1500>;
			ts = <20000 2000 (-20) 2>;
			thermal-zone = "gpu";
		};
	};
};
