## arch/arm64/configs/juno_mali_defconfig
```kconfig
CONFIG_SYSVIPC=y
CONFIG_POSIX_MQUEUE=y
CONFIG_USELIB=y
CONFIG_AUDIT=y
CONFIG_NO_HZ=y
CONFIG_HIGH_RES_TIMERS=y
CONFIG_BSD_PROCESS_ACCT=y
CONFIG_IKCONFIG=y
CONFIG_IKCONFIG_PROC=y
CONFIG_LOG_BUF_SHIFT=18
CONFIG_CGROUPS=y
CONFIG_CGROUP_PIDS=y
CONFIG_CGROUP_DEVICE=y
CONFIG_CPUSETS=y
CONFIG_MEMCG=y
CONFIG_BLK_CGROUP=y
CONFIG_CGROUP_SCHED=y
CONFIG_BLK_DEV_INITRD=y
CONFIG_KALLSYMS_ALL=y
CONFIG_EMBEDDED=y
CONFIG_SLAB=y
CONFIG_PROFILING=y
CONFIG_MODULES=y
CONFIG_MODULE_FORCE_LOAD=y
CONFIG_MODULE_UNLOAD=y
CONFIG_MODVERSIONS=y
CONFIG_ARCH_VEXPRESS=y
CONFIG_PCI=y
CONFIG_PCIEPORTBUS=y
CONFIG_HOTPLUG_PCI_PCIE=y
CONFIG_PCIE_ECRC=y
CONFIG_PCI_REALLOC_ENABLE_AUTO=y
CONFIG_PCI_PRI=y
CONFIG_PCI_PASID=y
CONFIG_HOTPLUG_PCI=y
CONFIG_PCI_HOST_GENERIC=y
CONFIG_SCHED_MC=y
CONFIG_SCHED_SMT=y
CONFIG_NR_CPUS=8
CONFIG_PREEMPT=y
CONFIG_CMA=y
CONFIG_CMDLINE="console=ttyAMA0"
CONFIG_BINFMT_MISC=y
CONFIG_COMPAT=y
CONFIG_CPU_IDLE_GOV_LADDER=y
CONFIG_ARM_CPUIDLE=y
CONFIG_CPU_FREQ=y
CONFIG_CPU_FREQ_STAT=y
CONFIG_CPU_FREQ_DEFAULT_GOV_INTERACTIVE=y
CONFIG_CPU_FREQ_GOV_USERSPACE=y
CONFIG_CPU_FREQ_GOV_ONDEMAND=y
CONFIG_ARM_BIG_LITTLE_CPUFREQ=y
CONFIG_ARM_DT_BL_CPUFREQ=y
CONFIG_ARM_SCPI_CPUFREQ=y
CONFIG_NET=y
CONFIG_PACKET=y
CONFIG_UNIX=y
CONFIG_XFRM_USER=y
CONFIG_NET_KEY=y
CONFIG_NET_KEY_MIGRATE=y
CONFIG_INET=y
CONFIG_IP_MULTICAST=y
CONFIG_IP_PNP=y
CONFIG_IP_PNP_DHCP=y
CONFIG_IP_PNP_BOOTP=y
CONFIG_IP_PNP_RARP=y
CONFIG_NETLABEL=y
# CONFIG_ANDROID_PARANOID_NETWORK is not set
CONFIG_NETFILTER=y
CONFIG_DEVTMPFS=y
CONFIG_DEVTMPFS_MOUNT=y
CONFIG_DMA_CMA=y
CONFIG_CMA_SIZE_MBYTES=64
CONFIG_CONNECTOR=y
CONFIG_MTD=y
CONFIG_MTD_CMDLINE_PARTS=y
CONFIG_MTD_BLOCK=y
CONFIG_MTD_OOPS=y
CONFIG_MTD_CFI=y
CONFIG_MTD_CFI_INTELEXT=y
CONFIG_MTD_NAND=y
CONFIG_VIRTIO_BLK=y
CONFIG_BLK_DEV_SD=y
CONFIG_ATA=y
CONFIG_SATA_SIL24=y
CONFIG_NETDEVICES=y
CONFIG_SKY2=y
CONFIG_SMC91X=y
CONFIG_SMSC911X=y
CONFIG_INPUT_EVDEV=y
CONFIG_SERIAL_AMBA_PL011=y
CONFIG_SERIAL_AMBA_PL011_CONSOLE=y
# CONFIG_HW_RANDOM is not set
CONFIG_I2C_DESIGNWARE_PLATFORM=y
CONFIG_GPIO_SYSFS=y
CONFIG_SENSORS_ARM_SCPI=y
CONFIG_THERMAL_WRITABLE_TRIPS=y
CONFIG_THERMAL_DEFAULT_GOV_POWER_ALLOCATOR=y
CONFIG_THERMAL_GOV_USER_SPACE=y
CONFIG_CPU_THERMAL=y
CONFIG_REGULATOR=y
CONFIG_REGULATOR_FIXED_VOLTAGE=y
CONFIG_DRM=y
CONFIG_DRM_LOAD_EDID_FIRMWARE=y
CONFIG_DRM_I2C_NXP_TDA998X=y
CONFIG_DRM_HDLCD=y
CONFIG_FB_ARMCLCD=y
CONFIG_FRAMEBUFFER_CONSOLE=y
CONFIG_LOGO=y
# CONFIG_LOGO_LINUX_MONO is not set
# CONFIG_LOGO_LINUX_VGA16 is not set
CONFIG_SOUND=y
CONFIG_SND=y
CONFIG_SND_SEQUENCER=y
CONFIG_SND_SEQ_DUMMY=y
CONFIG_SND_MIXER_OSS=y
CONFIG_SND_PCM_OSS=y
CONFIG_SND_SEQUENCER_OSS=y
# CONFIG_SND_USB is not set
CONFIG_SND_SOC=y
CONFIG_SND_DESIGNWARE_I2S=y
CONFIG_SND_SOC_SPDIF=y
CONFIG_SND_SIMPLE_CARD=y
CONFIG_USB_HIDDEV=y
CONFIG_USB=y
CONFIG_USB_EHCI_HCD=y
CONFIG_USB_EHCI_HCD_PLATFORM=y
CONFIG_USB_OHCI_HCD=y
CONFIG_USB_STORAGE=y
CONFIG_NOP_USB_XCEIV=y
CONFIG_USB_ULPI=y
CONFIG_MMC=y
CONFIG_MMC_ARMMMCI=y
CONFIG_RTC_CLASS=y
CONFIG_RTC_DRV_PL031=y
CONFIG_DMADEVICES=y
CONFIG_PL330_DMA=y
CONFIG_VIRTIO_MMIO=y
CONFIG_STAGING=y
CONFIG_ION=y
CONFIG_ION_DUMMY=y
CONFIG_COMMON_CLK_SCPI=y
CONFIG_ARM_TIMER_SP804=y
CONFIG_MAILBOX=y
CONFIG_ARM_MHU=y
CONFIG_PM_DEVFREQ=y
CONFIG_DEVFREQ_GOV_SIMPLE_ONDEMAND=y
CONFIG_DEVFREQ_GOV_PERFORMANCE=y
CONFIG_ANDROID=y
CONFIG_ARM_SCPI_PROTOCOL=y
CONFIG_ACPI=y
CONFIG_EXT2_FS=y
CONFIG_EXT3_FS=y
CONFIG_EXT3_FS_SECURITY=y
CONFIG_QUOTA=y
CONFIG_QFMT_V2=y
CONFIG_AUTOFS4_FS=y
CONFIG_MSDOS_FS=y
CONFIG_VFAT_FS=y
CONFIG_TMPFS=y
# CONFIG_EFIVAR_FS is not set
# CONFIG_MISC_FILESYSTEMS is not set
CONFIG_NFS_FS=y
CONFIG_NFS_V3_ACL=y
CONFIG_NFS_V4=y
CONFIG_ROOT_NFS=y
CONFIG_NLS_CODEPAGE_437=y
CONFIG_NLS_ISO8859_1=y
CONFIG_PRINTK_TIME=y
CONFIG_DYNAMIC_DEBUG=y
CONFIG_DEBUG_INFO=y
CONFIG_MAGIC_SYSRQ=y
CONFIG_PAGE_EXTENSION=y
CONFIG_LOCKUP_DETECTOR=y
CONFIG_SCHEDSTATS=y
CONFIG_TIMER_STATS=y
# CONFIG_DEBUG_PREEMPT is not set
CONFIG_FUNCTION_TRACER=y
CONFIG_DMA_API_DEBUG=y
# CONFIG_DEBUG_SET_MODULE_RONX is not set
CONFIG_SECURITY=y
CONFIG_SECURITY_NETWORK=y
CONFIG_SECURITY_NETWORK_XFRM=y
CONFIG_CRYPTO_CBC=y
CONFIG_CRYPTO_ECB=y
CONFIG_CRYPTO_MD5=y
CONFIG_CRYPTO_MICHAEL_MIC=y
CONFIG_CRC_T10DIF=y
CONFIG_CRC_ITU_T=y
CONFIG_CRC7=y
```

## drivers/bus/Kconfig
```kconfig
#
# Bus Devices
#

menu "Bus devices"

config IMX_WEIM
	bool "Freescale EIM DRIVER"
	depends on ARCH_MXC
	help
	  Driver for i.MX WEIM controller.
	  The WEIM(Wireless External Interface Module) works like a bus.
	  You can attach many different devices on it, such as NOR, onenand.

config MVEBU_MBUS
	bool
	depends on PLAT_ORION
	help
	  Driver needed for the MBus configuration on Marvell EBU SoCs
	  (Kirkwood, Dove, Orion5x, MV78XX0 and Armada 370/XP).

config OMAP_OCP2SCP
	tristate "OMAP OCP2SCP DRIVER"
	depends on ARCH_OMAP2PLUS
	help
	  Driver to enable ocp2scp module which transforms ocp interface
	  protocol to scp protocol. In OMAP4, USB PHY is connected via
	  OCP2SCP and in OMAP5, both USB PHY and SATA PHY is connected via
	  OCP2SCP.

config OMAP_INTERCONNECT
	tristate "OMAP INTERCONNECT DRIVER"
	depends on ARCH_OMAP2PLUS

	help
	  Driver to enable OMAP interconnect error handling driver.

config ARM_CCI
	bool "ARM CCI driver support"
	depends on ARM
	help
	  Driver supporting the CCI cache coherent interconnect for ARM
	  platforms.

config ARM_SYSTEM_PROFILER
	tristate "ARM System Profiler support"
	depends on ARM || ARM64
	depends on OF && DEBUG_FS
	help
	  Some ARM-based platforms contain a System Profiler component that can
	  provide profiling data about bus, interconnect and memory traffic
	  flowing through the system.  This can be useful for system tuning and
	  identifying performance bottlenecks.

	  Say Y or M here to provide support for obtaining profiling
	  information using the System Profiler.

	  If unsure, say N.

	  Note: For this to be anything more than a toy, you should also enable
	  ftrace (try ENABLE_DEFAULT_TRACERS).  This enables reporting of each
	  data capture via trace events.  Without this, you can still capture
	  data manually, but you will need to poll from userspace: reliability
	  and precision will suffer and overheads will be very high.

endmenu
```

## drivers/gpu/arm/midgard/platform/5422/Kconfig
```kconfig
#
# (C) COPYRIGHT 2014 ARM Limited. All rights reserved.
#
# This program is free software and is provided to you under the terms of the
# GNU General Public License version 2 as published by the Free Software
# Foundation, and any use by you of this program is subject to the terms
# of such GNU licence.
#
# A copy of the licence is included with the program, and can also be obtained
# from Free Software Foundation, Inc., 51 Franklin Street, Fifth Floor,
# Boston, MA  02110-1301, USA.
#
#

menuconfig MALI_MIDGARD_5422
	bool "5422 settings"
	depends on MALI_MIDGARD
	default y if MALI_PLATFORM_THIRDPARTY_NAME = "5422"
	help
	  Control 5422 specific options for the ARM Mali Midgard GPU.

config DYNIMIC_ABB
	bool "Enable dynimic abb"
	depends on MALI_MIDGARD_5422
	default n
	help
		Select this option to enable dynimic abb.
```

## drivers/gpu/arm/t6xx/kbase/Kconfig
```kconfig
#
# (C) COPYRIGHT 2012-2013 ARM Limited. All rights reserved.
#
# This program is free software and is provided to you under the terms of the
# GNU General Public License version 2 as published by the Free Software
# Foundation, and any use by you of this program is subject to the terms
# of such GNU licence.
#
# A copy of the licence is included with the program, and can also be obtained
# from Free Software Foundation, Inc., 51 Franklin Street, Fifth Floor,
# Boston, MA  02110-1301, USA.
#
#


menuconfig MALI_T6XX
	tristate "Mali-T6XX support"
	default n
	help
	  Enable this option to build support for the ARM Mali-T6XX GPU.

	  To compile this driver as a module, choose M here:
	  this will generate a single module, called mali_kbase.

config MALI_GATOR_SUPPORT
	bool "Streamline Debug support"
	depends on MALI_T6XX
	default n
	help
	  Adds diagnostic support for use with the ARM Streamline Performance Analyzer.
	  You will need the Gator device driver already loaded before loading this driver when enabling
	  Streamline debug support.

config MALI_T6XX_DVFS
	bool "Enable DVFS"
	depends on MALI_T6XX
	default n
	help
	  Choose this option to enable DVFS on MALI T6XX DDK.

config MALI_T6XX_RT_PM
	bool "Enable Runtime power management"
	depends on MALI_T6XX
	depends on PM_RUNTIME
	default n
	help
	  Choose this option to enable runtime power management on MALI T6XX DDK.

menuconfig MALI_T6XX_ENABLE_TRACE
	bool "Enable kbase tracing"
	depends on MALI_T6XX
	default y
	help
	  Enables tracing in kbase.  Trace log available through
	  the "mali_trace" debugfs file, when the CONFIG_DEBUG_FS is enabled

config MALI_EXYNOS_TRACE
	bool "Enable LSI trace"
	depends on MALI_T6XX && MALI_T6XX_ENABLE_TRACE
#	default y
	help
	  Enable tracing in kbase. It defined by S.LSI

config MALI_FULL_TRACE
	bool "Enable FULL trace"
	depends on MALI_T6XX && MALI_T6XX_ENABLE_TRACE
#	default n
	help
	  Enable tracing in kbase. It defined by ARM and work fully.

config MALI_T6XX_DEBUG_SYS
	bool "Enable sysfs for mali t6xx"
	depends on MALI_T6XX && SYSFS
	default n
	help
	  Enables sysfs for mali t6xx device. Set/Monitor Mali T6xx Device

# MALI_EXPERT configuration options

menuconfig MALI_EXPERT
	depends on MALI_T6XX
	bool "Enable Expert Settings"
	default n
	help
	  Enabling this option and modifying the default settings may produce a driver with performance or
	  other limitations.

config MALI_DEBUG_SHADER_SPLIT_FS
	bool "Allow mapping of shader cores via sysfs"
	depends on MALI_T6XX && MALI_T6XX_DEBUG_SYS && MALI_EXPERT
	default n
	help
	  Select this option to provide a sysfs entry for runtime configuration of shader
	  core affinity masks.

config MALI_PLATFORM_FAKE
	bool "Enable fake platform device support"
	depends on MALI_T6XX && MALI_EXPERT
	default n
	help
	  When you start to work with the Mali-T600 Series device driver the platform-specific code of
	  the Linux kernel for your platform may not be complete. In this situation the kernel device driver
	  supports creating the platform device outside of the Linux platform-specific code.
	  Enable this option if would like to use a platform device configuration from within the device driver.

config MALI_PLATFORM_THIRDPARTY
	depends on MALI_T6XX && MALI_EXPERT
	bool "Third Party Platform"
	default y
	help
	  Select the SOC platform that contains a Mali-T6XX

config MALI_PLATFORM_THIRDPARTY_NAME
	depends on MALI_T6XX && MALI_PLATFORM_THIRDPARTY && MALI_EXPERT
	string "Third party platform name"
	help
	  Enter the name of a third party platform that is supported. The third part configuration
	  file must be in kbase/src/linux/config/tpip/mali_kbase_config_xxx.c where xxx is the name
	  specified here.

config MALI_DEBUG
	bool "Debug build"
	depends on MALI_T6XX && MALI_EXPERT
	default n
	help
	  Select this option for increased checking and reporting of errors.

config MALI_NO_MALI
	bool "No Mali"
	depends on MALI_T6XX && MALI_EXPERT
	default n
	help
	  This can be used to test the driver in a simulated environment
	  whereby the hardware is not physically present. If the hardware is physically
	  present it will not be used. This can be used to test the majority of the
	  driver without needing actual hardware or for software benchmarking.
	  All calls to the simulated hardware will complete immediatly as if the hardware
	  completed the task.

config MALI_ERROR_INJECT
	bool "Error injection"
	depends on MALI_T6XX && MALI_EXPERT && MALI_NO_MALI
	default n
	help
	  Enables insertion of errors to test module failure and recovery mechanisms.

config MALI_TRACE_TIMELINE
	bool "Timeline tracing"
	depends on MALI_T6XX && MALI_EXPERT
	default n
	help
	  Enables timeline tracing through the kernel tracepoint system.

config MALI_SYSTEM_TRACE
	bool "Enable system event tracing support"
	depends on MALI_T6XX && MALI_EXPERT
	default n
	help
	  Choose this option to enable system trace events for each
	  kbase event.	This is typically used for debugging but has
	  minimal overhead when not in use. Enable only if you know what
	  you are doing.

config MALI_GPU_TRACEPOINTS
	bool "Enable GPU tracepoints"
	depends on MALI_T6XX && ANDROID
	select GPU_TRACEPOINTS
	help
	  Enables GPU tracepoints using Android trace event definitions.

source "drivers/gpu/arm/t6xx/kbase/src/platform/Kconfig"
```

## drivers/gpu/drm/arm/Kconfig
```kconfig
config DRM_ARM
	bool
	help
	  Choose this option to select drivers for ARM's devices

config DRM_MALI_DISPLAY
	tristate "ARM Mali Display Processor"
	depends on DRM && OF && (ARM || ARM64)
	depends on COMMON_CLK
	select DRM_ARM
	select DRM_KMS_HELPER
	select DRM_KMS_CMA_HELPER
	select DRM_GEM_CMA_HELPER
	select VIDEOMODE_HELPERS
	help
	  Choose this option if you want to compile the ARM Mali Display
	  Processor driver. It supports all the variants of the hardware.

	  If compiled as a module it will be called malidp.
```

## drivers/gpu/drm/arm/connector/Kconfig
```kconfig
# SPDX-License-Identifier: GPL-2.0
config SPLIT_CONNECTOR
	tristate "ARM split connect driver"
	depends on DRM && OF
	depends on COMMON_CLK
	select DRM_KMS_HELPER
	select DRM_KMS_CMA_HELPER
	select DRM_GEM_CMA_HELPER
	select VIDEOMODE_HELPERS
	help
	  Choose this option if you want to compile the ARM split connect
	  driver.
```

## drivers/gpu/drm/arm/display/Kconfig
```kconfig
# SPDX-License-Identifier: GPL-2.0
config DRM_KOMEDA
	tristate "ARM Komeda display driver"
	depends on DRM && OF
	depends on COMMON_CLK
	select DRM_KMS_HELPER
	select DRM_KMS_CMA_HELPER
	select DRM_GEM_CMA_HELPER
	select VIDEOMODE_HELPERS
	help
	  Choose this option if you want to compile the ARM Komeda display
	  Processor driver. It supports the D71 variants of the hardware.

	  If compiled as a module it will be called komeda.

config DRM_KOMEDA_ERROR_PRINT
	bool "Enable komeda error print"
	depends on DRM_KOMEDA
	help
	  Choose this option to enable error printing.

config ASSERTIVE_DISPLAY_TEST_MODULE
	tristate "ARM Assertive display test module driver"
	select IIO
	select IIO_BUFFER
	select IIO_BUFFER_CB
	select IIO_CONFIGFS
	select IIO_TRIGGER
	select IIO_SW_DEVICE
	select IIO_SW_TRIGGER
	select BACKLIGHT_LCD_SUPPORT
	select BACKLIGHT_CLASS_DEVICE
	select BACKLIGHT_GENERIC
	help
	  Choose this option if you want to enable backlight and ambient
	  light sensor for AD.

	  If compiled as a module it will be called ad_test_module.

config ASSERTIVE_DISPLAY
	tristate "ARM Assertive display driver"
	depends on DRM_KOMEDA
        select IIO
        select IIO_BUFFER
	select IIO_BUFFER_CB
        select IIO_CONFIGFS
        select IIO_TRIGGER
        select IIO_SW_DEVICE
        select IIO_SW_TRIGGER
        select BACKLIGHT_LCD_SUPPORT
        select BACKLIGHT_CLASS_DEVICE
        select BACKLIGHT_GENERIC
	help
	  Choose this option if you want to compile the ARM Assertive display
	  Processor driver. It supports the AD3 variants of the hardware.

	  If compiled as a module it will be called ad_drv.
```

## drivers/gud/Kconfig
```kconfig
#
# Mobicore Configuration
#

if SOC_EXYNOS5422
source "drivers/gud/gud-exynos5422/Kconfig"
endif

if SOC_EXYNOS5430
source "drivers/gud/gud-exynos5430/Kconfig"
endif

source "drivers/gud/sec-os-ctrl/Kconfig"
```
