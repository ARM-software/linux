## drivers/hardkernel/Kconfig
```kconfig
menu "ODROID Specific Hardware"

config ODROID_EXYNOS5_FAN
	bool "Enable the PWM Controlled FAN on ODROID-EXYNOS5"
	depends on MACH_ODROIDXU3
	default y
	---help---
		Enables the PWM Controlled FAN on ODROID-EXYNOS5

config ODROID_EXYNOS5_SP
	bool "Enable the INA231 Sensor on ODROID-EXYNOS5"
	depends on MACH_ODROIDXU3
	default n
	---help---
		Enables the INA231 Sensor on ODROID-EXYNOS5

config ODROID_EXYNOS5_IOBOARD
    bool "Enable the ODROID EXYNOS5 IOBOARD Drivers"
	depends on MACH_ODROIDXU3
	default n
	---help---
		Enables the IOBOARD Drivers

config ODROID_EXYNOS5_IOBOARD_DEBUG
    bool "Enable the ODROIDXU IOBOARD DEBUG Enable"
	depends on ODROID_EXYNOS5_IOBOARD
	default n
	---help---
		Enables the IOBOARD Debug Message

endmenu
```

## drivers/media/platform/arm/Kconfig
```kconfig
# SPDX-License-Identifier: GPL-2.0-only

config MALI_AEU
	tristate "arm MALI AFBC Encoder Unit"
	depends on OF && (ARM || ARM64)
	depends on VIDEO_DEV && VIDEO_V4L2
	select V4L2_MEM2MEM_DEV
	select VIDEOBUF2_DMA_CONTIG
	help
	  Support AEU device which could transfer the uncompressed buffer
	  to compressed buffer in AFBC format.
```

## drivers/media/platform/exynos/Kconfig
```kconfig
#
# Exynos multimedia device drivers
#
config VIDEO_EXYNOS
	bool "Exynos Multimedia Devices"
	depends on ARCH_EXYNOS4 || ARCH_EXYNOS5
	default y
	help
	  This is a representative exynos multimedia device.

if VIDEO_EXYNOS
	source "drivers/media/platform/exynos/mdev/Kconfig"
	source "drivers/media/platform/exynos/gsc_1.3/Kconfig"
	source "drivers/media/platform/exynos/gsc/Kconfig"
	source "drivers/media/platform/exynos/mfc/Kconfig"
	source "drivers/media/platform/exynos/hevc/Kconfig"
	source "drivers/media/platform/exynos/fimc-is/Kconfig"
	source "drivers/media/platform/exynos/scaler/Kconfig"
	source "drivers/media/platform/exynos/fimg2d/Kconfig"
	source "drivers/media/platform/exynos/jpeg4/Kconfig"
	source "drivers/media/platform/exynos/jpeg_hx/Kconfig"
	source "drivers/media/platform/exynos/tv/Kconfig"
endif

config MEDIA_EXYNOS
	bool
	help
	  Compile mdev to use exynos5 media device driver.
```

## drivers/media/platform/exynos/fimg2d/Kconfig
```kconfig
#
# Copyright (c) 2013 Samsung Electronics Co., Ltd.
#		http://www.samsung.com/
#
# Licensed under GPLv2

config VIDEO_EXYNOS_FIMG2D
	bool "Samsung Graphics 2D Driver"
	depends on VIDEO_EXYNOS
	default n
	---help---
	  This is a legacy driver for graphics 2D in Samsung ARM based SoC.

config FIMG2D_CCI_SNOOP
	bool "Enables CCI snoop control"
	depends on VIDEO_EXYNOS_FIMG2D
	default n
	---help---
	  This enables a CCI snoop control for cache coherency.
```

## drivers/media/platform/exynos/gsc_1.3/Kconfig
```kconfig
config VIDEO_EXYNOS_GSCALER_1_3
	bool "Exynos G-Scaler driver(ver1.3)"
	depends on VIDEO_EXYNOS
	select MEDIA_EXYNOS
	select V4L2_MEM2MEM_DEV
	default n
	help
	  This is a v4l2 driver for exynos G-Scaler device.

if VIDEO_EXYNOS_GSCALER_1_3 && VIDEOBUF2_CMA_PHYS
comment "Reserved memory configurations"
config VIDEO_SAMSUNG_MEMSIZE_GSC0
	int "Memory size in kbytes for GSC0"
	default "5120"

config VIDEO_SAMSUNG_MEMSIZE_GSC1
	int "Memory size in kbytes for GSC1"
	default "5120"
endif
```

## drivers/media/platform/exynos/hevc/Kconfig
```kconfig
config VIDEO_EXYNOS_HEVC
	bool "Exynos HEVC Driver"
	default y
	depends on VIDEO_EXYNOS
	select VIDEOBUF2_CORE
	select EXYNOS_HEVC_V1
	---help---
	  HEVC driver for V4L2.
```

## drivers/media/platform/exynos/jpeg4/Kconfig
```kconfig
#
# Configuration for JPEG
#

config VIDEO_EXYNOS_JPEG
	bool "Samsung JPEG_v4.x driver"
	depends on VIDEO_EXYNOS
	select MEDIA_EXYNOS
	select V4L2_MEM2MEM_DEV
	default n
	help
	  This is a Samsung JPEG H/W driver for V4.x
```

## drivers/media/platform/exynos/jpeg_hx/Kconfig
```kconfig
#
# Configuration for HX JPEG
#

config VIDEO_EXYNOS_HX_JPEG
	bool "Samsung JPEG_HX driver"
	depends on VIDEO_EXYNOS
	select MEDIA_EXYNOS
	select V4L2_MEM2MEM_DEV
	default n
	help
	  This is a Samsung HX JPEG H/W driver
```

## drivers/media/platform/exynos/scaler/Kconfig
```kconfig
config VIDEO_EXYNOS_SCALER
	bool "EXYNOS Scaler Driver"
	depends on VIDEO_EXYNOS && ARCH_EXYNOS5
	select V4L2_MEM2MEM_DEV
	default n
	help
	  This is a v4l2 driver for EXYNOS Scaler (MSCL) device.

config SCALER_NO_SOFTRST
	bool "Ignore SOFT_RESET control"
	depends on VIDEO_EXYNOS_SCALER
	default n
	---help---
	  This disables SOFT_RESET control for Exynos Scaler initial settings.
```

## drivers/misc/mipi-lli/Kconfig
```kconfig
#
# MIPI LLI
#

menuconfig MIPI_LLI
	tristate "MIPI LLI"
	default n
	help
	  It is for supporting MIPI LLI driver.

if MIPI_LLI
config EXYNOS_MIPI_LLI
	bool "Enable Exynos MIPI LLI"
	default y
	help
	  Enable MIPI LLI via Shared Memory.

config EXYNOS_MIPI_LLI_MPHY
	bool "Enable Exynos MIPI LLI MPHY"
	default y
	depends on EXYNOS_MIPI_LLI
	help
	  Enable M-PHY for MIPI-LLI

endif # MIPI_LLI
```

## drivers/net/wireless/rtl8192cu_v40/Kconfig
```kconfig
config RTL8192CU_V40
	tristate "Realtek 8192C USB WiFi"
	depends on USB
	select WIRELESS_EXT
	select WEXT_PRIV
	---help---
	  Enable wireless network adapters based on Realtek RTL8192C chipset family, such as EDUP nano series
```

## drivers/staging/android/ion/exynos/Kconfig
```kconfig
config ION_EXYNOS_OF
	depends on OF
	bool "Setup ION with Device Tree"
	default n

menu "Region definitions of exynos-contig-heap"
	depends on !ION_EXYNOS_OF
config ION_EXYNOS_SIZE_COMMON
	int "Size in kilobytes of common pool of exynos-contig-heap"
	default 0

config ION_EXYNOS_SIZE_MFC_SH
	int "Size in kilobytes of mfc_sh region"
	default 0

config ION_EXYNOS_SIZE_MSGBOX_SH
	int "Size in kilobytes of msgbox_sh region"
	default 0

config ION_EXYNOS_SIZE_FIMD_VIDEO
	int "Size in kilobytes of fimd_video region"
	default 0

config ION_EXYNOS_SIZE_GSC
	int "Size in kilobytes of gsc region"
	default 0

config ION_EXYNOS_SIZE_MFC_OUTPUT
	int "Size in kilobytes of mfc_output region"
	default 0

config ION_EXYNOS_SIZE_MFC_INPUT
	int "Size in kilobytes of mfc_input region"
	default 0

config ION_EXYNOS_SIZE_MFC_FW
	int "Size in kilobytes of mfc_fw region"
	default 0

config ION_EXYNOS_SIZE_SECTBL
	int "Size in kilobytes of sectbl region"
	default 0

config ION_EXYNOS_SIZE_G2D_WFD
	int "Size in kilobytes of g2d_wfd region"
	default 0

config ION_EXYNOS_SIZE_VIDEO
	int "Size in kilobytes of video region"
	default 0

config ION_EXYNOS_SIZE_MFC_NFWVIDEO
	int "Size in kilobytes of mfc_nfw region"
	default 0
endmenu
```

## drivers/video/decon_display/Kconfig
```kconfig
menuconfig DECON
	bool "Samsung Display Enhancement Controller(DECON)"
	select FB_CFB_FILLRECT
	select FB_CFB_COPYAREA
	select FB_CFB_IMAGEBLIT
	select S5P_DEV_MIPI_DSIM0
	depends on FB

config DECON_FB
	bool "Samsung DECON Framebuffer driver"
	depends on DECON
	default y

config DECON_MIC
	bool "Samsung MIC driver"
	depends on DECON_FB
	default n

config FB_I80_COMMAND_MODE
	bool "DECON FB I80 MODE"
	depends on DECON_FB
	default n

choice
	prompt "I80 Trigger Mode"
	depends on FB_I80_COMMAND_MODE

	config FB_I80_HW_TRIGGER
	bool "I80 Hardware Trigger Mode"

	config FB_I80_SW_TRIGGER
	bool "I80 Software Trigger Mode"

endchoice

config FB_HIBERNATION_DISPLAY
	bool "FB Hibernation Display MODE"
	depends on FB_I80_COMMAND_MODE
	default n

config FB_HIBERNATION_DISPLAY_CLOCK_GATING
	bool "Support clock-gating"
	depends on FB_HIBERNATION_DISPLAY
	default y

config FB_HIBERNATION_DISPLAY_POWER_GATING
	bool "Support power-gating"
	depends on FB_HIBERNATION_DISPLAY_CLOCK_GATING
	default n

config FB_HIBERNATION_DISPLAY_POWER_GATING_DEEPSTOP
	bool "Support power-gating with deep-stop"
	depends on FB_HIBERNATION_DISPLAY_POWER_GATING
	default n

config DECON_DISPLAY
	bool "Samsung DECON DISPLAY driver"
	depends on DECON
	default y

config DECON_MIPI_DSI
	bool "Samsung DECON MIPI-DSI driver"
	depends on DECON
	default n

config DECON_LCD
	depends on DECON
	bool "Select LCD panel driver"

config DECON_LCD_S6E8AA0
	depends on DECON_LCD && DECON_MIPI_DSI
	tristate "S6E8AA0 AMOLED HD LCD driver(800 x 1280)"

config DECON_LCD_S6E3FA0
	depends on DECON_LCD && DECON_MIPI_DSI
	tristate "S6E8FA0 AMOLED FULL HD LCD driver(1080 x 1920)"

config DECON_LCD_PARALLEL_RGB
	depends on DECON_LCD && !DECON_MIPI_DSI
	tristate "LCD_480w_PARALLEL_RGB 800x 480"

config S5P_DEV_MIPI_DSIM0
	bool
```

## drivers/video/decon_tv_display/Kconfig
```kconfig
config DECON_TV
	bool "Samsung Display Enhancement Controller Television(DECON_TV)"
	depends on FB

if DECON_TV
config DECON_TV_FB
	bool "Samsung DECON_TV Framebuffer driver"
	depends on DECON_TV
	default y
	help
	  Say Y here if you want support for the DECON_TV in Samsung S5P SoCs.
	  This device produce image data to one of output interfaces.

config VIDEO_EXYNOS_HDMI
	bool "Samsung HDMI driver"
	depends on DECON_TV
	depends on VIDEO_V4L2
	select SWITCH
	select FB_MODE_HELPERS
	default y
	help
	  Say Y here if you want support for the HDMI output
	  interface in S5P Samsung SoC. The driver can be compiled
	  as module. It is an auxiliary driver, that exposes a V4L2
	  subdev for use by other drivers. This driver requires
	  hdmiphy driver to work correctly.

config VIDEO_EXYNOS_HDMI_AUDIO_I2S
	bool "Enable HDMI audio using I2S path"
	depends on DECON_TV
	depends on VIDEO_EXYNOS_HDMI
	depends on SND_SAMSUNG_I2S
	default y
	help
	  Enables HDMI audio through I2S path.

config VIDEO_EXYNOS_HDMI_AUDIO_SPDIF
	bool "Enable HDMI audio using SPDIF path"
	depends on DECON_TV
	depends on VIDEO_EXYNOS_HDMI
	depends on SND_SOC_SAMSUNG_SMDK_SPDIF
	default n
	help
	  Enables HDMI audio through SPDIF path.

config VIDEO_EXYNOS_HDMI_CEC
	tristate "Samsung HDMI CEC Driver"
	depends on DECON_TV
	depends on VIDEO_DEV && VIDEO_V4L2 && I2C
	default n
	help
	  Say Y here if you want support for the HDMI CEC
	  interface in S5P Samsung SoC. The driver can be compiled
	  as module.
endif
```

## sound/soc/samsung/seiren/Kconfig
```kconfig
config SND_SAMSUNG_SEIREN
    bool "SEIREN Audio support"
    depends on SND_SOC_SAMSUNG && SND_SAMSUNG_AUDSS
    help
      Say Y if you want to support SEIREN AUDIO.
```
