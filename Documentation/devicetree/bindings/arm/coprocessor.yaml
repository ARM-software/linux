## Documentation/devicetree/bindings/arm/coprocessor.yaml
```yaml
title: Arm Komeda Co-Processor

maintainers:
  - James Qian Wang <james.qian.wang@arm.com>

properties:
  compatible:
    enum:
      - arm,coprocessor_client

  reg:
    maxItems: 1

  port:
    maxItems: 1

required:
  - compatible
  - reg
  - port

additionalProperties: false

examples:
  co-processors {
    compatible = "simple-bus";
    #address-cells = <1>;
    #size-cells = <0>;

    cp0: co-processor@0 {
      compatible = "arm,coprocessor_client";
      reg = <0>;
      port {
        cp0_in: endpoint {
          remote-endpoint = <&dp0_out1>;
        };
      };
    };
  };
```

## Documentation/devicetree/bindings/arm/system-profiler.txt
```
=======================================
ARM System Profiler binding description
=======================================

The ARM system profiler is a generic interface to special-purpose performance
monitors that can provide profiling data about bus, interconnect and memory
traffic flowing through the system.


Node: system-profiler

	Description: describes a single system profiler instance

	Node name must be "system-profiler".

system-profiler node properties:

	- compatible
		Usage: required

		Value type: <string>

		Definition: must be set to
			    "arm,system-profiler"

	- reg
		Usage: required

		Value type: <prop-encoded-array>

		Definition: A standard property.  Specifies base physical
			    address and size of the system profiler register
			    block, including the monitor registers.

	- ranges
		Usage: required

		Value type: <prop-encoded-array>

		Definition: A standard property.  Specifies how the system
			profiler register space maps onto the parent bus.  This
			mapping must place the start of the first monitor
			register block (monitor 0) at address 0 in the system
			profiler address space.

	- #address-cells
		Usage: required unless #address-cells inherited from the parent
			has value <1>.

		Value: <1>

		Specifies the number of cells used to represent the ID of each
		monitor.

	- #size-cells
		Usage: required

		Value: <0>

		No size cells are associated with a monitor ID.

	- interrupts
		Usage: recommended

		Value type: <prop-encoded-array> containing a single interrupt
			    specifier

		Definition: A standard property.  specifier for the system
			    profiler interrupt.

			    The system profiler can do software driven capture
			    without an interrupt connected, but if the
			    interrupt is available in the hardware it should be
			    described here in order to enable interrupt-driven
			    capture.

system-profiler node children:

	- monitor
		Usage: A monitor node must be present for each usable monitor
			connected to the system profiler

			A monitor node must not be present for any monitor that
			is not present in the hardware or not connected to
			anything.

		Placement: must be a child of a system-profiler node.

		Name: must be "monitor".

monitor node:

	- reg
		Usage: required

		Value type: <cell>

		Definition: The ID of the monitor.

	- type
		Usage: required.

		Value type: <string>

		Definition: Identifies the monitor type.  Must be one of the
			following:

			"axi"		- AXI Bus Monitor (ABM)
			"cci"		- CCI Performance Monitor (CPM)
			"memory"	- Memory Performance Monitor (MPM)

	- target
		Usage: optional

		Value type: <string>

		Definition: Free-form string describing what the monitor
			is connected to.

			Recommended when there are multiple monitors of the
			same type, since it makes it easier for a user to
			identify each monitor does.


Example:

	interrupt-parent = <&gic>;
	#address-cells = <2>;
	#size-cells = <2>;

	system-profiler@46400000 {
		compatible = "arm,system-profiler";
		reg = <0x0 0x46400000 0 0x100000>;

		#address-cells = <1>;
		#size-cells = <0>;

		interrupts = <GIC_SPI 27 4>;

		monitor@0 {
			type = "axi";
			reg = <0>;
			target = "cpu-cluster:cortex-a57";
		};

		monitor@2 {
			type = "axi";
			reg = <1>;
			target = "gpu:mali-t6xx";
		};

		monitor@3 {
			type = "axi";
			reg = <3>;
			target = "link:cci-slave-s1";
		};

		monitor@4 {
			type = "axi";
			reg = <4>;
			target = "link:cci-to-pcie";
		};

		monitor@7 {
			type = "axi";
			reg = <7>;
			target = "dram:s1";
		};

		monitor@b {
			type = "cci";
			reg = <0xb>;
		};

		monitor@c {
			type = "memory";
			reg = <0xc>;
		};
	};
```

## Documentation/devicetree/bindings/display/arm,komeda.txt
```
Device Tree bindings for Arm Komeda display driver

Required properties:
- compatible: Should be "arm,mali-d71"
- reg: Physical base address and length of the registers in the system
- interrupts: the interrupt line number of the device in the system
- clocks: A list of phandle + clock-specifier pairs, one for each entry
    in 'clock-names'
- clock-names: A list of clock names. It should contain:
    - "aclk": for the main processor clock
- #address-cells: Must be 1
- #size-cells: Must be 0
- iommus: configure the stream id to IOMMU, Must be configured if want to
    enable iommu in display. for how to configure this node please reference
      devicetree/bindings/iommu/arm,smmu-v3.txt,
      devicetree/bindings/iommu/iommu.txt
- side_by_side_master[optional]:
    only availiable when side_by_side is needed, to specific the master
    pipeline to the side_by_side, NOTE the master is the output pipeline.
    Two endpoints will be enabled if side_by_side_master is set.
    Allowed values: <0>, <1>
    The default value is 0.

Required properties for sub-node: pipeline@nq
Each device contains one or two pipeline sub-nodes (at least one), each
pipeline node should provide properties:
- reg: Zero-indexed identifier for the pipeline
- clocks: A list of phandle + clock-specifier pairs, one for each entry
    in 'clock-names'
- clock-names: should contain:
    - "pxclk": pixel clock

- port: each pipeline contains one or two output ports, for binding to the
    connected external transmitter or coprocessor.
    A specific port contains:
    - reg: <0>, <1>, for indicating the types of connected device, 0 is
        for transmitter, 1 is for coprocessor.
    - remote-endpoint: The phandle of the 'input' endpoint of the attached
        video transmitter device or the attached co-processor client.

Optional properties:
  - memory-region: phandle to a node describing memory (see
    Documentation/devicetree/bindings/reserved-memory/reserved-memory.txt)
    to be used for the framebuffer; if not present, the framebuffer may
    be located anywhere in memory.

  - lpu_raxi_aoutstdcapb:
    AXI outstanding transcations capability during active region.
    range [4 -> 64], default 32.

  - lpu_raxi_boutstdcapb:
    AXI outstanding transcations capability during blanking region.
    range [4 -> 64], default 32.

  - lpu_raxi_ben: Outstanding capability during blanking regsion enable flag.
    Allowed: <0>, <1>, default: 0

  - lpu_raxi_burstlen: AXI read burst length in bytes.
    Allowed: <4>, <8>, <16>, <32>,  default: 16

  - lpu_raxi_arqos: AXI reading QoS. range [0 -> 15]. default: 15.

  - lpu_raxi_ord: AXI transcations generation mode.
    Allowed: <0>, <1>,  default: 0

  - lpu_waxi_outstdcapb: AXI outstanding write transcations capability.
    range [1 -> 16], default 16.

  - lpu_waxi_burstlen: AXI write burst length in bytes.
    Allowed: <4>, <8>, <16>, <32>,  default: 16

  - lpu_waxi_awqos: AXI writing QoS. range [0 -> 15]. default: 15.

  - lpu_waxi_ord: AXI transcations generation mode for writing.
    Allowed: <0>, <1>,  default: 0

  - lpu_l0_arcache: Layer0 AXI read transaction memory (cache) type.
    range [0->15], default 3.
  - lpu_l1_arcache: Layer1 AXI read transaction memory (cache) type.
    range [0->15], default 3.
  - lpu_l2_arcache: Layer2 AXI read transaction memory (cache) type.
    range [0->15], default 3.
  - lpu_l3_arcache: Layer3 AXI read transaction memory (cache) type.
    range [0->15], default 3.
  - lpu_lw_awcache: Write-back AXI write transaction memory (cache) type.
    range [0->15], default 3.

  - lpu_tbu_doutstdcapb: DTI outstanding transcations capability.
    range [0 -> 16], default 8

Example:
/ {
	...

	dp0: display@c00000 {
		#address-cells = <1>;
		#size-cells = <0>;
		compatible = "arm,mali-d71";
		reg = <0xc00000 0x20000>;
		interrupts = <0 168 4>;
		clocks = <&dpu_aclk>;
		clock-names = "aclk";
		iommus = <&smmu 0>, <&smmu 1>, <&smmu 2>, <&smmu 3>,
			<&smmu 4>, <&smmu 5>, <&smmu 6>, <&smmu 7>,
			<&smmu 8>, <&smmu 9>;

		side_by_side_master = <0>;
		dp0_pipe0: pipeline@0 {
			reg = <0>;
			clocks = <&fpgaosc2>;
			clock-names = "pxclk";

			lpu_raxi_aoutstdcapb = <32>;
			lpu_raxi_boutstdcapb = <32>;
			lpu_raxi_ben = <0>;
			lpu_raxi_burstlen = <16>;
			lpu_raxi_arqos = <15>;
			lpu_raxi_ord = <0>;
			lpu_waxi_outstdcapb = <16>;
			lpu_waxi_burstlen = <16>;
			lpu_waxi_awqos = <15>;
			lpu_waxi_ord = <0>;
			lpu_l0_arcache = <3>;
			lpu_l1_arcache = <3>;
			lpu_l2_arcache = <3>;
			lpu_l3_arcache = <3>;
			lpu_lw_arcache = <3>;
			lpu_tbu_doutstdcapb = <8>;

			ports {
				#address-cells = <1>;
				#size-cells = <0>;

				port@0 {
					#address-cells = <1>;
					#szie-cells = <0>;
					reg = <0>;
					dp_pl0_link0: endpoint@0 {
						reg = <0>;
					};
					dp_pl0_link1: endpoint@1 {
						reg = <1>;
					};
				};
				port@1 {
					reg = <1>;
					dp_pl0_out1: endpoint {
						remote-endpoint = <&cp0_in>;
					};
				};
			};
		};

		dp0_pipe1: pipeline@1 {
			clocks = <&fpgaosc2>;
			clock-names = "pxclk";
			reg = <1>;

			ports {
				#address-cells = <1>;
				#size-cells = <0>;

				port@0 {
					reg = <0>;
				};
			};
		};
	};

	co-processors {
		compatible = "simple-bus";
		#address-cells = <1>;
		#size-cells = <0>;

		cp0: co-processor@0 {
			compatible = "arm,coprocessor_client";
			reg = <0>;
			port {
				cp0_in: endpoint {
					remote-endpoint = <&dp_pl0_out1>;
				};
			};
		};
		/* cp1 .... */
	};

	...
};
```

## Documentation/devicetree/bindings/display/arm,mali-ad3.txt
```
* ARM Assertiveness Display version 3  (mali-ad3)

Required properties:
- compatible: Should be "arm,ad-v3".
- reg: Physical base address and length of the registers in the system
- clocks: should contain a phandle + clock-specifier pair for each clock
entry in clock-names.
- clock-names: should contain:
      * "aclk": AXI interface clock
- firmware_name: The name of ad3 firmware file,
which can be put in the kernel default firmware path /lib/firmware.
- io-channels: List of phandle and IIO specifier pairs,one pair for each
IIO input to the device.
Note: for ad3, there's only one IIO pair to match the light input from
IIO ambient light spicifier.
- backlight: phandle of the backlight device attached to AD3.
Note: this is required if the platform uses the backlight device as
the backlight control.
- led_trigger: the ad3 trigger assigned to the LED as the default trigger.
Note: this is required if the platform uses the LED as the backlight control.

Optional properties:
- io-channel-names: List of IIO input name strings sorted in the same order
as the io-channels property.
Note: ad3 can use io-channel-names to match IIO input names with the IIO ambient
light spicifier.

Example:

/{
        ...

        ad0: ad@d00000 {
                compatible = "arm,ad-v3";
                clocks = <&dpu_aclk>;
                clock-names = "aclk";
                reg = <0xd00000 0x584>;
                firmware_name = "ad.bin";
                io-channels = <&als 0>;
                io-channel-names = "als0";
                led_trigger = "AD3";
	};

	...
};
```

## Documentation/devicetree/bindings/display/virtual-encoder.txt
```
DRM Virtual Encoder

The DRM Virtual Encoder is a component-based basic encoder that fetches
the display timings information from the device tree and "discovers" a
DRM output with the given data. It is helpful in a simulated environment
where there is no actual hardware to be probed and the configuration of
the display happens outside the kernel world.

Required properties:
  - compatible: should be "drm,virtual-encoder"

Optional properties:
  - command_mode: This is the single frame refresh mode(which can be used on
    mipi dsi command mode display panels) in which the output is disabled unless
    the DPU software driver loads another scene while the current frame is being
    displayed.
  - vfp-range: This denotes the "variable refresh rate" feature supports enabled.
    The range value has min and max "vertical front porch" value of the connector.

Required sub-nodes:
  - display-timings: node describing the virtual output timings information,
    as specified in panel/display-timing.txt file.
  - port: the input port connection as modelled using the OF graph bindings
    specified in Documentation/devicetree/bindings/graph.txt


Example:

/ {
	...

	vencoder {
		compatible = "drm,virtual-encoder";
		command_mode = "true";
		vfp-range = <33 534>;
		display-timings {
			native-mode = <&timing1>;
			timing0: timing@0 {
				/* 640x480 framebuffer */
				clock-frequency = <23750>;
				hactive = <640>;
				vactive = <480>;
				hfront-porch = <48>;
				hback-porch = <16>;
				hsync-len = <96>;
				vfront-porch = <33>;
				vback-porch = <9>;
				vsync-len = <3>;
			};
			timing1: timing@1 {
				/* 1280x720 framebuffer */
				clock-frequency = <74440000>;
				hactive = <1280>;
				vactive = <720>;
				hfront-porch = <56>;
				hback-porch = <192>;
				hsync-len = <136>;
				vfront-porch = <1>;
				vback-porch = <22>;
				vsync-len = <3>;
			};
		};

		port {
			vencoder_in: endpoint {
				remote-endpoint = <&driver_out>;
			};
		};
	};

	drm_driver: driver@f00bad {
		...

		port {
			driver_out: endpoint {
				remote-endpoint = <&vencoder_in>;
			};
		};

		...
	};

	...
};
```

## Documentation/devicetree/bindings/drm/i2c/tda998x.txt
```
Device-Tree bindings for the NXP TDA998x HDMI transmitter

Required properties;
  - compatible: must be "nxp,tda998x"

  - reg: I2C address

Optional properties:
  - interrupts: interrupt number and trigger type
	default: polling

  - pinctrl-0: pin control group to be used for
	screen plug/unplug interrupt.

  - pinctrl-names: must contain a "default" entry.

  - video-ports: 24 bits value which defines how the video controller
	output is wired to the TDA998x input - default: <0x230145>

  - audio-ports: one or two values corresponding to entries in
       the audio-port-names property.

  - audio-port-names: must contain "i2s", "spdif" entries
       matching entries in the audio-ports property.

  - #sound-dai-cells: must be set to <1> for use with the simple-card.
       The DAI 0 is the I2S input and the DAI 1 is the S/PDIF input.

Example:

	tda998x: hdmi-encoder {
		compatible = "nxp,tda998x";
		reg = <0x70>;
		interrupt-parent = <&gpio0>;
		interrupts = <27 2>;		/* falling edge */
		pinctrl-0 = <&pmx_camera>;
		pinctrl-names = "default";

		audio-ports = <0x03>, <0x04>;
		audio-port-names = "i2s", "spdif";
		#sound-dai-cells = <1>;
         };
	};
```
