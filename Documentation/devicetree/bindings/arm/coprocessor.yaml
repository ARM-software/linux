## Documentation/devicetree/bindings/gpu/arm,hdlcd.txt
```
ARM HDLCD

This is a driver for a display controller found on several development
platforms produced by ARM Ltd and in more modern of its' Fast Models.
The HDLCD is an RGB streamer that reads the data from a framebuffer
and sends it to a single HDMI transmitter.

Required properties:
- compatible: "arm,hdlcd"
- reg: Physical base address and length of the controller's registers.
- interrupts: One interrupt used by the controller to multiplex all
  the sources programmed in the interrupt mask register.
- clocks: A list of phandle + clock-specifier pairs, one for each entry
  in clock-names.
- clock-names: A list of clock names. For HDLD it should containt:
   * "pxlclk" for the clock feeding the output PLL of the controller.

Optional properties:
- i2c-slave: If the HDLCD is connected to an HDMI transmitter that is
  reacheable via i2c, then use the phandle of the DDC slave here.

Optional children:
- display-timings: If the HDLCD is emulated by the Fast Model, place the
  videomode(s) of the desired resolution(s) here. If multiple videomodes
  are being used, a 'native-mode' property should be used to indicate the
  preferred/default resolution. Refer to
  Documentation/devicetree/bindings/video/display-timing.txt for details.


Example:

/ {
	...

	hdlcd@2b000000 {
		compatible = "arm,hdlcd";
		reg = <0 0x2b000000 0 0x1000>;
		interrupts = <0 85 4>;
		i2c-slave = <&dvi_i2c_slave>;
		clocks = <&oscclk5>;
		clock-names = "pxlclk";
	};

	/* DVI I2C bus */
	v2m_i2c_dvi: i2c@160000 {
		compatible = "arm,versatile-i2c";
		reg = <0x160000 0x1000>;

		#address-cells = <1>;
		#size-cells = <0>;

		dvi_i2c_slave: dvi-transmitter@39 {
			compatible = "sil,sii9022-tpi", "sil,sii9022";
			reg = <0x39>;
		};

		dvi-transmitter@60 {
			compatible = "sil,sii9022-cpi", "sil,sii9022";
			reg = <0x60>;
		};
	};

	...
};
```

## Documentation/devicetree/bindings/mailbox/arm,mhu.txt
```
ARM Message Handling Unit(MHU)
------------------------------

Required properties:

- compatible : should be "arm,mhu"
- reg : exactly one register range with length 0x1000(4kB)
- interrupts : list of interrupt specifiers associated with the device
- interrupt-names : contains names of the interrupt in the order in which
		    they were specified in the interrupts property
- #mbox-cells : number of cells in a mailbox specifier, should be 1.
		The 'mboxes' specifier should be a linear index to the
		mailbox this device supports.

See Documentation/devicetree/bindings/mailbox/mailbox.txt
for more details about the generic mailbox controller and
client driver bindings.

Example:

mailbox: mhu@2b1f0000 {
	compatible = "arm,mhu";
	reg = <0x0 0x2b1f0000 0x0 0x1000>;
	interrupts = <0 35 4>,
		     <0 36 4>;
	interrupt-names = "mhu_hpri_rx",
			  "mhu_lpri_rx";
	#mbox-cells = <1>;
};
```

## Documentation/devicetree/bindings/mailbox/arm,scpi.txt
```
System Control and Power Interface (SCPI) Message Protocol
----------------------------------------------------------

Required properties:

- compatible : should be "arm,scpi"
- mboxes: List of phandle and mailbox channel specifiers
- shmem : List of phandle pointing to the shared memory(SHM) area between the
	  processors using these mailboxes for IPC, one for each mailbox

See Documentation/devicetree/bindings/mailbox/mailbox.txt
for more details about the generic mailbox controller and
client driver bindings.

Clock bindings for the clocks based on SCPI Message Protocol
------------------------------------------------------------

This binding uses the common clock binding[1].

Required properties:
- compatible : shall be one of the following:
	"arm,scpi-clocks" - for the container node with all the clocks
		based on the SCPI protocol
	"arm,scpi-dvfs" - all the clocks that are variable and index based.
		These clocks don't provide the full range between the limits
		but only discrete points within the range. The firmware
		provides the mapping for each such operating frequency and the
		index associated with it. The firmware also manages the
		voltage scaling appropriately with the clock scaling.
	"arm,scpi-clk" - all the clocks that are variable and provide full
		range within the specified range. The firmware provides the
		supported range for each clock.

Required properties for all clocks(all from common clock binding):
- #clock-cells : should be set to 1 as each of the SCPI clocks have multiple
	outputs. The clock specifier will be the index to an entry in the list
	of output clocks.
- clock-output-names : shall be the corresponding names of the outputs.
- clock-indices: The identifyng number for the clocks(clock_id) in the node as
	expected by the firmware. It can be non linear and hence provide the
	mapping	of identifiers into the clock-output-names array.

[1] Documentation/devicetree/bindings/clock/clock-bindings.txt

Example:

sram: sram@50000000 {
	compatible = "arm,juno-sram-ns", "mmio-sram";
	reg = <0x0 0x50000000 0x0 0x10000>;

	#address-cells = <1>;
	#size-cells = <1>;
	ranges = <0 0x0 0x50000000 0x10000>;

	cpu_scp_lpri: scp-shmem@0 {
		compatible = "arm,juno-scp-shmem";
		reg = <0x0 0x200>;
	};

	cpu_scp_hpri: scp-shmem@200 {
		compatible = "arm,juno-scp-shmem";
		reg = <0x200 0x200>;
	};
};

mailbox: mailbox0@40000000 {
	....
	#mbox-cells = <1>;
};

scpi_protocol: scpi@2e000000 {
	compatible = "arm,scpi";
	mboxes = <&mailbox 0 &mailbox 1>;
	shmem = <&cpu_scp_lpri &cpu_scp_hpri>;

	clocks {
		compatible = "arm,scpi-clocks";

		scpi_dvfs: scpi_clocks@0 {
			compatible = "arm,scpi-dvfs";
			#clock-cells = <1>;
			clock-indices = <0>, <1>, <2>;
			clock-output-names = "vbig", "vlittle", "vgpu";
		};
		scpi_clk: scpi_clocks@3 {
			compatible = "arm,scpi-clk";
			#clock-cells = <1>;
			clock-indices = <3>, <4>;
			clock-output-names = "pxlclk0", "pxlclk1";
		};
	};
};

cpu@0 {
	...
	reg = <0 0>;
	clocks = <&scpi_dvfs 0>;
	clock-names = "big";
};

hdlcd@7ff60000 {
	...
	reg = <0 0x7ff60000 0 0x1000>;
	clocks = <&scpi_clk 1>;
	clock-names = "pxlclk";
};

In the above example, the #clock-cells is set to 1 as required.
scpi_dvfs has 3 output clocks namely: vbig, vlittle and vgpu with 0, 1
and 2 as clock-indices. scpi_clk has 2 output clocks namely: pxlclk0 and
pxlclk1 with 3 and 4 as clock-indices.

The first consumer in the example is cpu@0 and it has vbig as input clock.
The index '0' in the clock specifier here points to the first entry in the
output clocks of scpi_dvfs for which clock_id asrequired by the firmware
is 0.

Similarly the second example is hdlcd@7ff60000 and it has pxlclk0 as input
clock. The index '1' in the clock specifier here points to the second entry
in the output clocks of scpi_clocks for which clock_id as required by the
firmware is 4.
```

## Documentation/devicetree/bindings/mailbox/arm-mhu.txt
```
ARM MHU Mailbox Driver
======================

The ARM's Message-Handling-Unit (MHU) is a mailbox controller that has
3 independent channels/links to communicate with remote processor(s).
 MHU links are hardwired on a platform. A link raises interrupt for any
received data. However, there is no specified way of knowing if the sent
data has been read by the remote. This driver assumes the sender polls
STAT register and the remote clears it after having read the data.
The last channel is specified to be a 'Secure' resource, hence can't be
used by Linux running NS.

The MHU drives the interrupt signal using a 32-bit register, with all
32-bits logically ORed together. It provides a set of registers to
enable software to set, clear and check the status of each of the bits
of this register independently. The use of 32 bits per interrupt line
enables software to provide more information about the source of the
interrupt. For example, each bit of the register can be associated with
a type of event that can contribute to raising the interrupt. Each of
the 32-bits can be used as "doorbell" to alert the remote processor.

Mailbox Device Node:
====================

Required properties:
--------------------
- compatible:		Shall be "arm,mhu" & "arm,primecell"
- reg:			Contains the mailbox register address range (base
			address and length)
- #mbox-cells		Shall be 1 - the index of the channel needed when
			not used as set of doorbell bits.
			Shall be 2 - the index of the channel needed, and
			the index of the doorbell bit within the channel
			when used in doorbell mode.
- interrupts:		Contains the interrupt information corresponding to
			each of the 3 physical channels of MHU namely low
			priority non-secure, high priority non-secure and
			secure channels.

Example:
--------

1. Controller which doesn't support doorbells

	mhu: mailbox@2b1f0000 {
		#mbox-cells = <1>;
		compatible = "arm,mhu", "arm,primecell";
		reg = <0 0x2b1f0000 0x1000>;
		interrupts = <0 36 4>, /* LP-NonSecure */
			     <0 35 4>, /* HP-NonSecure */
			     <0 37 4>; /* Secure */
		clocks = <&clock 0 2 1>;
		clock-names = "apb_pclk";
	};

	mhu_client: scb@2e000000 {
		compatible = "fujitsu,mb86s70-scb-1.0";
		reg = <0 0x2e000000 0x4000>;
		mboxes = <&mhu 1>; /* HP-NonSecure */
	};

2. Controller which supports doorbells

	mhu: mailbox@2b1f0000 {
		#mbox-cells = <2>;
		compatible = "arm,mhu", "arm,primecell";
		reg = <0 0x2b1f0000 0x1000>;
		interrupts = <0 36 4>, /* LP-NonSecure */
			     <0 35 4>; /* HP-NonSecure */
		clocks = <&clock 0 2 1>;
		clock-names = "apb_pclk";
	};

	mhu_client: scb@2e000000 {
		compatible = "arm,scpi";
		reg = <0 0x2e000000 0x200>;
		mboxes = <&mhu 1 4>; /* HP-NonSecure 5th doorbell bit */
	};
```

## Documentation/devicetree/bindings/media/arm/mali-aeu.txt
```
// SPDX-License-Identifier: GPL-2.0
#
# (C) COPYRIGHT 2019 ARM Limited. All rights reserved.
# Author: Jonathan Chai (jonathan.chai@arm.com)
#

* ARM AFBC ENCODER Unit devices (mali-aeu)

Required properties:
- compatible: Should be "arm,mali-aeu".
- reg: Physical base address and length of the registers in the system
- interrupts: the interrupt line numbers of the device in the system
- interrupt-names: contains the names of the IRQs in the order they were
provided in the "interrupts" property. Must contain: "APU".
- clocks: should contain a phandle + clock-specifier pair for each clock
entry in clock-names.
- clock-names: should contain:
      * "aclk": AXI interface clock

Optional properties:
- iommus: configure the stream id to IOMMU, Must be configured if want to
      enable iommu in aeu. for how to configure this node please reference
          devicetree/bindings/iommu/arm,smmu-v3.txt,
          devicetree/bindings/iommu/iommu.txt

- aeu-axi-burst-length: this is the burst length in bytes that the AEU will use
  for reading data from the AXI interface.
  Allowed parameters are: <4>, <8>, <16>, <32>
  The default value is 32.

- aeu-axi-outstdcab: this is AXI outstanding transcations capability during
  active region. Valid value range 4 - 16. The debault value is 16.

- aeu-axi-arqos: AXI QoS. Valid value range 0 - 15. The default value is 15.

- aeu-arcache: Layer AXI read transcations memory type. Valid value range 0 - 15.
  The default value is 3.

- aeu-axi-ord: AXI transactions generation mode. Value 0 means out-of-order AXI mode,
  value 1 means in-order AXI mode. The default value is 0.

- aeu-axi-awqos: AXI QoS for writing. Valid value range 0 - 15. The default value is 0.

- aeu-awchache: Write-back layer AXI write transcations memory type.
  Valid value range 0 - 15. The default value is 3.

- memory-region: phandle to a node describing memory to be used for the video buffers.
  If not present, the video buffers may be located in anywhere in memory.
  (Refer to: Documentation/devicetree/bindings/reserved-memory/reserved-memory.txt)

Example:

/{
	...

	aeu@6fc20000 {
		compatible = "arm,mali-aeu";
		reg = <0 0x6fc20000 0 0x20000>;
		clocks =  <&fpgaosc1>;
		clock_names = "dp_aclk";
		interrupts = <0 168 4>;
		interrupt-names = "AEU";
		iommus = <&smmu 10>, <&smmu 11>;
		aeu-axi-ord = <0>;
		memory-region = <&aeu_reserved>;
	};

	...
};
```

## Documentation/devicetree/bindings/misc/malidp-reset.txt
```
* Mali-DP Reset Widget

This node is for a reset widget included in Mali-DP development bitfiles. It
provides an interface to the HW reset lines of the Mali-DP device(s).

Required properties:
- compatible: Should be "arm,malidp-reset"
- reg: The register location and length (length should be 4)

Optional properties:
- mask: The default reset mask to use (if not specified, a driver-internal
default is used). This should be a 3-bit number, where the bits have the
following meanings:
 bit 2: Global reset
 bit 1: Primary core reset
 bit 0: Secodary core reset

Example:

	widget0: widget@0x6f020058 {
		compatible = "arm,malidp-reset";
		reg = <0 0x6f020058 0 0x4>;
		mask = <0x7>;
	};
```

## Documentation/devicetree/bindings/pci/arm,pcie-xr3.txt
```
PLDA XpressRICH3-AXI PCIe controller.

These bindings describe the host controller as implemented on ARM's Juno
platforms. Because IP integration has added additional registers to the
original IP it is expected that other vendors will have different bindings
if not different drivers.

Required properties:
- compatible: Should be "arm,pcie-xr3" to identify the controller
- device_type: Must be "pci"
- reg: A list of physical base addresses and lengths. There must be 3
  entries:
     - PLDA's XpressRICH3-AXI configuration registers
     - ARM's reset registers
     - Configuration space (ECAM compliant)
- bus-range: Range of bus numbers associated with this controller
- linux,pci-domain: PCI domain number (ACPI's segment) associated with
  this controller.
- #address-cells: Address representation for root ports (must be 3),
  in accordance with the ePAPR specification.
- #size-cells: Size representation for root ports (must be 2)
- ranges: Describes the translation of addresses for standard PCI
  regions. Please consult the standard device tree bindings for PCI
  host bridges on how to encode the ranges.
- #interrupt-cells: Size representation for legacy interrupts (must be 1)
- interrupt-map-mask and
- interrupt-map: Standard PCI IRQ mapping properties. Please refer to the
  standard PCI bus binding document for a more detailed explanation

Optional properties:
- msi-parent: Handle to an MSI controller that will be used to request
  allocation of MSI interrupts.

Example:

	pcie-controller@30000000 {
		compatible = "arm,pcie-xr3";
		device_type = "pci";
		reg = <0 0x7ff30000 0 0x1000		/* XR3 config registers */
		       0 0x7ff20000 0 0x10000		/* XR3 reset registers */
		       0 0x40000000 0 0x10000000>;	/* ECAM config space */
		bus-range = <0 255>;
		linux,pci-domain = <0>;
		#address-cells = <3>;
		#size-cells = <2>;
		ranges = <0x01000000 0x00 0x5ff00000 0x00 0x5ff00000 0x0 0x00100000
			  0x02000000 0x00 0x50000000 0x00 0x50000000 0x0 0x0f000000
		          0x42000000 0x40 0x00000000 0x40 0x00000000 0x0 0x80000000
			  0x02000000 0x40 0x80000000 0x40 0x80000000 0x0 0x80000000>;
		#interrupt-cells = <1>;
		interrupt-map-mask = <0 0 0 7>;
		interrupt-map = <0 0 0 1 &gic 0 0 0 136 4
			         0 0 0 2 &gic 0 0 0 137 4
				 0 0 0 3 &gic 0 0 0 138 4
				 0 0 0 4 &gic 0 0 0 139 4>;
		msi-parent = <&v2m_0>;
	};
```
